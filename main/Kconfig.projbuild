## main/Kconfig.projbuild
```kconfig
menu "Example Configuration"

    config MESH_ROUTER_SSID
        string "Router SSID"
        default "bumblebee"
        help
            Router SSID.

    config MESH_ROUTER_PASSWD
        string "Router password"
        default "cherrycookies"
        help
            Router password.

    choice
        bool "Mesh AP Authentication Mode"
        default WIFI_AUTH_WPA2_PSK
        help
            Authentication mode.

        config WIFI_AUTH_OPEN
            bool "WIFI_AUTH_OPEN"
        config WIFI_AUTH_WPA_PSK
            bool "WIFI_AUTH_WPA_PSK"
        config WIFI_AUTH_WPA2_PSK
            bool "WIFI_AUTH_WPA2_PSK"
        config WIFI_AUTH_WPA_WPA2_PSK
            bool "WIFI_AUTH_WPA_WPA2_PSK"
    endchoice

    config MESH_AP_AUTHMODE
        int
        default 0 if WIFI_AUTH_OPEN
        default 2 if WIFI_AUTH_WPA_PSK
        default 3 if WIFI_AUTH_WPA2_PSK
        default 4 if WIFI_AUTH_WPA_WPA2_PSK
        help
            Mesh AP authentication mode.   
            
    config FW_VERSION_MAJOR
        int "Major version"
        default 0
        range 0 99
        help
            Major version number (0-99)

    config FW_VERSION_MINOR
        int "Minor version" 
        default 1
        range 0 99
        help
            Minor version number (0-99)

    config FW_VERSION_PATCH
        int "Patch version"
        default 2
        range 0 99
        help
            Patch version number (0-99)

endmenu
```

## sdkconfig.defaults
```kconfig
# Compiler optimizations
CONFIG_COMPILER_OPTIMIZATION_PERF=y
CONFIG_COMPILER_OPTIMIZATION_ASSERTIONS_DISABLE=y

# FreeRTOS optimizations
CONFIG_FREERTOS_HZ=1000
CONFIG_FREERTOS_USE_TRACE_FACILITY=n
CONFIG_FREERTOS_USE_STATS_FORMATTING_FUNCTIONS=n
CONFIG_FREERTOS_VTASKLIST_INCLUDE_COREID=n
CONFIG_FREERTOS_GENERATE_RUN_TIME_STATS=n
CONFIG_FREERTOS_TIMER_TASK_STACK_DEPTH=4096

# WiFi optimizations
CONFIG_ESP32_WIFI_STATIC_RX_BUFFER_NUM=16
CONFIG_ESP32_WIFI_DYNAMIC_RX_BUFFER_NUM=64
CONFIG_ESP32_WIFI_STATIC_TX_BUFFER_NUM=16
CONFIG_ESP32_WIFI_DYNAMIC_TX_BUFFER_NUM=64
CONFIG_ESP32_WIFI_RX_BA_WIN=32
CONFIG_ESP32_WIFI_TX_BA_WIN=32
CONFIG_ESP32_WIFI_AMPDU_RX_ENABLED=y
CONFIG_ESP32_WIFI_AMPDU_TX_ENABLED=y
CONFIG_ESP32_WIFI_AMSDU_TX_ENABLED=y
CONFIG_ESP32_WIFI_NVS_ENABLED=n

# TCP/IP optimizations  
CONFIG_LWIP_TCP_SND_BUF_DEFAULT=65536
CONFIG_LWIP_TCP_WND_DEFAULT=65536
CONFIG_LWIP_TCP_RECVMBOX_SIZE=32
CONFIG_LWIP_UDP_RECVMBOX_SIZE=32
CONFIG_LWIP_TCPIP_RECVMBOX_SIZE=64
CONFIG_LWIP_TCP_MSS=1460
CONFIG_LWIP_RECV_BUFSIZE_DEFAULT=1460

# LWIP
CONFIG_LWIP_IP_FORWARD=y
CONFIG_LWIP_IPV4_NAPT=y

# Bridge configuration
CONFIG_BRIDGE_DATA_FORWARDING_NETIF_SOFTAP=y

# Mesh-Lite settings
CONFIG_MESH_LITE_NODE_INFO_REPORT=y
CONFIG_MESH_LITE_ENABLE=y
CONFIG_MESH_LITE_VENDOR_ID_0=44
CONFIG_MESH_LITE_VENDOR_ID_1=55
CONFIG_MESH_LITE_ID=42
CONFIG_MESH_LITE_MAX_ROUTER_NUMBER=1
CONFIG_MESH_LITE_MAXIMUM_LEVEL_ALLOWED=2
CONFIG_MESH_LITE_NODE_INFO_REPORT=y
CONFIG_MESH_LITE_REPORT_INTERVAL=20
CONFIG_MESH_LITE_MAXIMUM_NODE_NUMBER=20
CONFIG_JOIN_MESH_WITHOUT_CONFIGURED_WIFI_INFO=y
CONFIG_JOIN_MESH_IGNORE_ROUTER_STATUS=y
CONFIG_DEVICE_CATEGORY="bumblebee_CCU"

# Memory optimizations
CONFIG_ESP32_SPIRAM_SUPPORT=n
CONFIG_SPIRAM_USE_MALLOC=n
CONFIG_ESP_SYSTEM_EVENT_QUEUE_SIZE=64
CONFIG_ESP_SYSTEM_EVENT_TASK_STACK_SIZE=4096

# Flash optimizations  
CONFIG_ESPTOOLPY_FLASHMODE_QIO=y
CONFIG_ESPTOOLPY_FLASHFREQ_80M=y
ESPTOOLPY_HEADER_FLASHSIZE_UPDATE=n
CONFIG_ESPTOOLPY_FLASHSIZE_4MB=y
CONFIG_ESPTOOLPY_FLASHMODE="qio"

# Power management (disabled for performance)
CONFIG_PM_ENABLE=n
CONFIG_ESP32_DEFAULT_CPU_FREQ_240=y
CONFIG_ESP32_DEFAULT_CPU_FREQ_MHZ=240

# Log level optimizations (reduce for production)
CONFIG_LOG_DEFAULT_LEVEL_INFO=y
CONFIG_LOG_MAXIMUM_EQUALS_DEFAULT=y

# Task watchdog optimizations
CONFIG_ESP_TASK_WDT_TIMEOUT_S=10
CONFIG_ESP_TASK_WDT_CHECK_IDLE_TASK_CPU0=n
CONFIG_ESP_TASK_WDT_CHECK_IDLE_TASK_CPU1=n

# Bluetooth disabled for WiFi performance
CONFIG_BT_ENABLED=n

# Additional performance settings
CONFIG_ESP32_ENABLE_COREDUMP_TO_NONE=y
CONFIG_ESP32_PANIC_PRINT_HALT=y

#Partition table
CONFIG_PARTITION_TABLE_TWO_OTA_LARGE=y

#Mesh-Lite OTA 
CONFIG_ESP_MESH_LITE_OTA_ENABLE=y
CONFIG_OTA_DATA_LEN=1376
CONFIG_OTA_WND_DEFAULT=8256
CONFIG_OTA_AUTO_RESTART=y
CONFIG_OTA_AUTO_CANCEL_ROLLBACK=y

#OTA Settings
CONFIG_BOOTLOADER_APP_ROLLBACK_ENABLE=y
CONFIG_BOOTLOADER_APP_ANTI_ROLLBACK=n
CONFIG_MBEDTLS_SSL_IN_CONTENT_LEN=4096
CONFIG_MBEDTLS_SSL_OUT_CONTENT_LEN=4096
CONFIG_MBEDTLS_SSL_PROTO_TLS1_3=y
```
